#include <reg51.h>
#include <nokia5110.h>
#include "intrins.h"
extern unsigned char g_ucTempbuf[20]; 
unsigned char code shuzi_nokia[]={
0xF8,0x04,0x04,0x04,0xF8,0x00,0x01,0x02,0x02,0x02,0x01,0x00,/*"0",0*/

0x00,0x08,0xFC,0x00,0x00,0x00,0x00,0x02,0x03,0x02,0x00,0x00,/*"1",1*/
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0x00,0x00,0x00,0x00,0x00,0x00,0x00,0x00,0x00,0x00,0x00,0x00,/*" ",37*/

};



unsigned char code hanzi[]={


0x10,0x14,0x94,0xD4,0x7F,0x54,0x5C,0x54,0x52,0x50,0x10,0x00,
0x02,0x01,0x00,0x01,0x01,0x01,0x01,0x09,0x09,0x07,0x00,0x00,/*"考",0*/

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0x08,0x05,0x01,0x05,0x09,0x01,0x05,0x09,0x01,0x05,0x08,0x00,/*"点",34*/


};

void delayms(unsigned  int ii)//1ms延时函数
{
	unsigned int i,x;
	for (x=0;x<ii;x++)
	{
	for (i=0;i<200;i++);
	}
;
}

/*--------------------------------------------
LCD_write_byte: 使用SPI接口写数据到LCD
输入参数：dt：写入的数据；
command ：写数据/命令选择；
编写日期：20080918 
----------------------------------------------*/
void LCD_write_byte(unsigned char dt, unsigned char command)
{
	unsigned char i; 
	sce=0;	
	dc=command;	
	for(i=0;i<8;i++)
	{ 
		if(dt&0x80)
		sdin=1;	
		else
			sdin=0;
		dt=dt<<1;		
		sclk=0; 		
		sclk=1; 
	}	
	dc=1;	
	sce=1;	
	sdin=1;
}
/*---------------------------------------
LCD_init: 3310LCD初始化
编写日期：20080918 
-----------------------------------------  */
void LCD_init(void)
{
	res=0;  	
  	delayms(10);
  	res=1;  
	LCD_write_byte(0x21,0);//初始化Lcd,功能设定使用扩充指令
	LCD_write_byte(0xCD,0);//设定液晶偏置电压
	LCD_write_byte(0x20,0);//使用基本指令
	LCD_write_byte(0x0C,0);//设定显示模式，正常显示,普通显示
}
/*-------------------------------------------
LCD_set_XY: 设置LCD坐标函数
输入参数：X：0－83  Y：0－5
编写日期：20080918 
---------------------------------------------*/
void LCD_set_XY(unsigned char X, unsigned char Y)
{
	LCD_write_byte(0x40 | Y, 0);// column设置y地址命令字
	LCD_write_byte(0x80 | X, 0);// row设置x地址命令字
} 
/*------------------------------------------
LCD_clear: LCD清屏函数
编写日期：20080918 
--------------------------------------------*/
void LCD_clear(void)
{
	unsigned char t;
	unsigned char k;
	LCD_set_XY(0,0);
	for(t=0;t<6;t++)
	{ 
		for(k=0;k<84;k++)
		{ 
			LCD_write_byte(0x00,1);
				
		} 
	}
}
/*---------------------------------------------
LCD_write_shu: 显示6（宽）*16（高）点阵列数字字母符号等半角类
输入参数：c：显示的字符；
编写日期：20080918 
-----------------------------------------------*/
void LCD_write_shu(unsigned char row, unsigned char page,unsigned char c) //row:列 page:页 dd:字符
{
	unsigned char i;  	
	
	LCD_set_XY(row*6, page);// 列，页 
	for(i=0; i<6;i++) 
	{
		LCD_write_byte(shuzi_nokia[c*12+i],1); 
	}
	
    LCD_set_XY(row*6, page+1);// 列，页 
	for(i=6; i<12;i++) 
	{
		LCD_write_byte(shuzi_nokia[c*12+i],1);
	}	 	
}
/*---------------------------------------------
LCD_write_hanzi: 显示12（宽）*16（高）点阵列汉字等半角类
输入参数：c：显示的字符；
编写日期：20080918 
-----------------------------------------------*/
void LCD_write_hanzi(unsigned char row, unsigned char page,unsigned char c) //row:列 page:页 dd:字符
{
	unsigned char i;  	
	
	LCD_set_XY(row*6, page);// 列，页 
	for(i=0; i<12;i++) 
	{
		LCD_write_byte(hanzi[c*24+i],1); 
	}
	
    LCD_set_XY(row*6, page+1);// 列，页 
	for(i=12; i<24;i++) 
	{
		LCD_write_byte(hanzi[c*24+i],1);
	}	
}

void display_type()//寻到卡后显示出该卡的类型
{
    unsigned char first,second;
    LCD_clear(); //清屏幕	     
    LCD_write_hanzi(0,0,19);  	
	LCD_write_hanzi(2,0,20);  
 	LCD_write_hanzi(4,0,21);  	
	LCD_write_hanzi(6,0,22);

    first=(g_ucTempbuf[0]&0xf0)>>4;
	LCD_write_shu(8,0,first);//写数字
    second=g_ucTempbuf[0]&0x0f;
	LCD_write_shu(9,0,second);//写数字
    first=(g_ucTempbuf[1]&0xf0)>>4;
	LCD_write_shu(10,0,first);//写数字
    second=g_ucTempbuf[1]&0x0f;
	LCD_write_shu(11,0,second);//写数字
}



